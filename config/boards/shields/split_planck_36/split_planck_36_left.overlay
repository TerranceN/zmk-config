#include "split_planck_36.dtsi"

&kscan0 {
  row-gpios
    = <&pro_micro 5 (GPIO_ACTIVE_HIGH | GPIO_PULL_DOWN)> // row a from the schematic file
    , <&pro_micro 15 (GPIO_ACTIVE_HIGH | GPIO_PULL_DOWN)> // row b from the schematic file
    , <&pro_micro 8 (GPIO_ACTIVE_HIGH | GPIO_PULL_DOWN)> // row c from the schematic file
    , <&pro_micro 6 (GPIO_ACTIVE_HIGH | GPIO_PULL_DOWN)> // row d from the schematic file
    ;

  col-gpios
    = <&pro_micro  2 GPIO_ACTIVE_HIGH> // col1 in the schematic
    , <&pro_micro  7 GPIO_ACTIVE_HIGH> // col2 in the schematic
    , <&pro_micro 14 GPIO_ACTIVE_HIGH> // col3 in the schematic
    , <&pro_micro 16 GPIO_ACTIVE_HIGH> // col4 in the schematic
    , <&pro_micro 10 GPIO_ACTIVE_HIGH> // col5 in the schematic
    ;
};
