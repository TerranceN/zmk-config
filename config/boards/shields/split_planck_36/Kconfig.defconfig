## config/boards/shields/split_planck_36/Kconfig.defconfig
```kconfig
if SHIELD_SPLIT_PLANCK_36_LEFT

config ZMK_KEYBOARD_NAME
	default "SplitPlanck"

config ZMK_SPLIT_BLE_ROLE_CENTRAL
	default y

endif

if SHIELD_SPLIT_PLANCK_36_RIGHT

config ZMK_KEYBOARD_NAME
	default "SplitPlanckRight"

endif

if SHIELD_SPLIT_PLANCK_36_RIGHT || SHIELD_SPLIT_PLANCK_36_LEFT

config ZMK_SPLIT
	default y

endif
```

## config/boards/shields/split_planck_36/Kconfig.shield
```kconfig
config SHIELD_SPLIT_PLANCK_36_LEFT    def_bool $(shields_list_contains,split_planck_36_left)
config SHIELD_SLIT_PLANCK_36_RIGHT    def_bool $(shields_list_contains,split_planck_36_right)
```
